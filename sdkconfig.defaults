## sdkconfig.defaults
```kconfig
# Setup Serial monitoring.
CONFIG_ESP_CONSOLE_UART_BAUDRATE=115200
CONFIG_LOG_DEFAULT_LEVEL_INFO=y

# Flash configs and customer partition
CONFIG_PARTITION_TABLE_CUSTOM=y
CONFIG_PARTITION_TABLE_CUSTOM_FILENAME="partitions.csv"
CONFIG_PARTITION_TABLE_FILENAME="partitions.csv"
CONFIG_ESPTOOLPY_FLASHSIZE_4MB=y

# Enable Bluetooth
CONFIG_BT_ENABLED=y
CONFIG_BT_NIMBLE_ENABLED=y
CONFIG_BT_CTRL_SCAN_DUPL_TYPE=1

# Software coexistence for WiFi and Bluetooth
CONFIG_ESP_COEX_SW_COEXIST_ENABLE=y
CONFIG_BTDM_CTRL_FULL_SCAN_SUPPORTED=y

# WiFi Buffer Optimization for Scanning
CONFIG_ESP_WIFI_DYNAMIC_RX_MGMT_BUF=10

# Set to -1 to allow these tasks to run on any available core
CONFIG_BT_NIMBLE_PINNED_TO_CORE=-1
CONFIG_ESP_WIFI_TASK_PINNED_TO_CORE=-1

# Compiler optimzations
CONFIG_COMPILER_OPTIMIZATION_PERF=y
CONFIG_COMPILER_OPTIMIZATION_LEVEL_RELEASE=y
```
